## boot/zephyr/boards/nrf52840dk_nrf52840.conf
```kconfig
# Use RSA instead of ECDSA
CONFIG_BOOT_SIGNATURE_TYPE_ECDSA_P256=n
CONFIG_BOOT_SIGNATURE_TYPE_RSA=y
CONFIG_BOOT_SIGNATURE_TYPE_RSA_LEN=2048
CONFIG_BOOT_SIGNATURE_KEY_FILE="FirmwareSigningKey.pem"

CONFIG_BOOT_ENCRYPT_RSA=y
# key found in keys.c

CONFIG_LOG=n
#CONFIG_LOG_MODE_MINIMAL=n
#CONFIG_LOG_DEFAULT_LEVEL=4

#
# We are not a DK anymore
#
CONFIG_GPIO_AS_PINRESET=n
CONFIG_BOARD_ENABLE_DCDC=n
```
